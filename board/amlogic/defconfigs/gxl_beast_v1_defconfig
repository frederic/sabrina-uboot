## board/amlogic/defconfigs/gxl_beast_v1_defconfig
```kconfig
CONFIG_ARM=y
CONFIG_TARGET_MESON_GX=y
CONFIG_GXL_SEI210_V1=y
CONFIG_DM=y
CONFIG_DM_GPIO=y
CONFIG_AML_GPIO=y
```

## board/harman/Kconfig
```kconfig
config ATOM_V1
	bool "Support harman atom v1 board"
	default n

if ATOM_V1
source "board/harman/atom_v1/Kconfig"
endif
```

## board/harman/atom_v1/Kconfig
```kconfig
if TARGET_MESON_TXLX

config SYS_CPU
	string
	default "armv8"

config SYS_BOARD
	string
	default "atom_v1"

config SYS_VENDOR
	string
	default "harman"

config SYS_SOC
	string
	default "txlx"

config SYS_CONFIG_NAME
	default "atom_v1"

endif
```
